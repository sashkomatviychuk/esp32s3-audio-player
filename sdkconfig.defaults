## src/Kconfig.projbuild
```kconfig
menu "MP3 player: audio debug"

    config AUDIO_DEBUG_MODE
        bool "Single-file debug mode"
        default n
        help
            audio_task always plays AUDIO_DEBUG_FILENAME from the SD card and
            ignores the track list. player_state exposes a single track in
            this mode (Next/Prev/Select have nothing to switch to); the
            display shows the played file name on the highlighted row and a
            'D' marker in the header.

    config AUDIO_DEBUG_FILENAME
        string "File played in debug mode"
        default "demo_audio.wav"
        depends on AUDIO_DEBUG_MODE
        help
            File name at the SD card mount point, e.g. demo_audio.mp3.

    config AUDIO_DEBUG_MP3_INFO_LOG
        bool "Log first MP3 frame header details"
        default n
        help
            Logs bitrate, sample rate, channel mode and Xing duration found
            by mp3_get_info() for every track that starts playing.

    choice AUDIO_DEBUG_SPI_MASTER_LOG_LEVEL
        prompt "spi_master log level"
        default AUDIO_DEBUG_SPI_MASTER_LOG_INFO
        help
            Debug level prints a "deviceN release bus" line per transfer.

        config AUDIO_DEBUG_SPI_MASTER_LOG_WARN
            bool "Warning"
        config AUDIO_DEBUG_SPI_MASTER_LOG_INFO
            bool "Info"
        config AUDIO_DEBUG_SPI_MASTER_LOG_DEBUG
            bool "Debug"
    endchoice

endmenu
```
